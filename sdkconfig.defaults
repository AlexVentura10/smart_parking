## sdkconfig.defaults
```kconfig
# Frequência da CPU
CONFIG_ESP_DEFAULT_CPU_FREQ_MHZ_160=y
# CONFIG_ESP_DEFAULT_CPU_FREQ_MHZ_240=y

# Suporte a PSRAM (Espressif SPIRAM)
CONFIG_SPIRAM=y
CONFIG_SPIRAM_BOOT_INIT=y

# Otimização do Compilador para Desempenho
CONFIG_COMPILER_OPTIMIZATION_PERF=y
```
